## CMakeLists.txt
```
cmake_minimum_required(VERSION 3.22.1)

find_package(Zephyr REQUIRED HINTS $ENV{ZEPHYR_BASE})

project(balance_bot C)

target_sources(app PRIVATE
    src/main.c
    src/motors_gazebo.c
)
```

## prj.conf
```kconfig
# Generic networking options
CONFIG_NETWORKING=y
CONFIG_NET_UDP=y
CONFIG_NET_TCP=y
CONFIG_NET_IPV6=n
CONFIG_NET_IPV4=y
CONFIG_NET_SOCKETS=y
CONFIG_POSIX_API=y
CONFIG_NET_CONNECTION_MANAGER=y

CONFIG_SHELL=y
CONFIG_EVENTFD=y
CONFIG_ZVFS_POLL_MAX=41
CONFIG_ZVFS_EVENTFD_MAX=8

# Kernel options
CONFIG_MAIN_STACK_SIZE=2048
CONFIG_ENTROPY_GENERATOR=y
CONFIG_TEST_RANDOM_GENERATOR=y
CONFIG_INIT_STACKS=y
# Logging
CONFIG_NET_LOG=y
CONFIG_LOG=y
CONFIG_NET_STATISTICS=y
CONFIG_PRINTK=y

# Network buffers
CONFIG_NET_PKT_RX_COUNT=16
CONFIG_NET_PKT_TX_COUNT=16
CONFIG_NET_BUF_RX_COUNT=64
CONFIG_NET_BUF_TX_COUNT=64
CONFIG_NET_CONTEXT_NET_PKT_POOL=y

# IP address options
CONFIG_NET_IF_UNICAST_IPV6_ADDR_COUNT=3
CONFIG_NET_IF_MCAST_IPV6_ADDR_COUNT=4
CONFIG_NET_MAX_CONTEXTS=10

# Network shell
CONFIG_NET_SHELL=y
CONFIG_SHELL=y

CONFIG_ETH_NATIVE_TAP=n
CONFIG_NET_DRIVERS=y
CONFIG_NET_SOCKETS=y
CONFIG_NET_SOCKETS_OFFLOAD=y
CONFIG_NET_NATIVE_OFFLOADED_SOCKETS=y
CONFIG_NET_IPV6_DAD=n

CONFIG_NANOPB=y

CONFIG_ZBUS=y
CONFIG_ZBUS_ASYNC_LISTENER=y
CONFIG_ZBUS_RUNTIME_CHANNEL_REGISTRATION=y
CONFIG_ZBUS_RUNTIME_OBSERVERS=y
CONFIG_ZBUS_CHANNEL_ID=y
CONFIG_ZBUS_CHANNEL_NAME=y

CONFIG_SENSOR=y
CONFIG_SENSOR_SHELL=y

CONFIG_CBPRINTF_FP_SUPPORT=y

# DSP library
CONFIG_CMSIS_DSP=y
```

## src/motors.h
```c
/* motors.h Control motors' velocity for a balance bot.
 *
 * This is a simple API for the balance bot application that allows to control
 * the velocity of the motors in the system.
 *
 * The purpose of this module is to show how to implement a simulated variant
 * of some custom hadware control logic using the gazebo bridge. In that case,
 * the implementation is provided by the 'motors_gazebo.c' file.
 */
#ifndef MOTORS_H_
#define MOTORS_H_

#include <stdbool.h>

enum motor_instance {
    MOTOR_LEFT,
    MOTOR_RIGHT,
};

bool motors_init(void);

/* Set velocity for a motor instance. */
bool motor_force_set(enum motor_instance motor, double force);

#endif /* MOTORS_H_ */
```

## src/motors_gazebo.c
```c
/* motors_gazebo.c Implementation of motors.h API for simulation purposes.
 *
 */

#include "gz_message.pb.h"
#include "gz/msgs/double.pb.h"
#include "motors.h"
#include "pb.h"
#include <pb_encode.h>
#include <pb_decode.h>
#include <zephyr/device.h>
#include <drivers/gz_bridge.h>

#define WHEEL_RIGHT_TOPIC "/wheel_right"
#define WHEEL_LEFT_TOPIC "/wheel_left"

#define DOUBLE_URL "/gz.msgs.Double"

/* Find the bridge node */
#define BRIDGE DT_COMPAT_GET_ANY_STATUS_OKAY(gz_bridge)

const struct device *bridge = DEVICE_DT_GET(BRIDGE);

static const char *get_topic_name(enum motor_instance motor)
{
    switch(motor) {
    case MOTOR_LEFT:
        return WHEEL_LEFT_TOPIC;
    case MOTOR_RIGHT:
        return WHEEL_RIGHT_TOPIC;
    default:
        return NULL;
    }
}

bool motors_init(void)
{
    /* Register Zephyr->Gazebo channels */
    int ret = gz_bridge_register_channel(bridge, "/wheel_right", ZEPHYR_TO_GAZEBO, NULL);
    ret = gz_bridge_register_channel(bridge, "/wheel_left", ZEPHYR_TO_GAZEBO, NULL);
    return 0;
}

bool motor_force_set(enum motor_instance motor, double force)
{
    GazeboMessage tx_msg = GazeboMessage_init_default;
    gz_msgs_Double dbl = gz_msgs_Double_init_zero;

    const char *topic_name = get_topic_name(motor);
    if (!topic_name) {
        return false;
    }

    dbl.data = force;

    strncpy(tx_msg.topic, topic_name, sizeof(tx_msg.topic));

    gz_bridge_encode_nested(&tx_msg, gz_msgs_Double_fields, DOUBLE_URL, &dbl);

    gz_bridge_send_message(bridge, topic_name, &tx_msg);

    return true;
}
```
