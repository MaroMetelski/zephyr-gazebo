## drivers/Kconfig
```kconfig
menuconfig GAZEBO_DRIVERS
    bool "Gazebo bridge and drivers"

if GAZEBO_DRIVERS

rsource "gz_bridge/Kconfig"
rsource "sensor/Kconfig"

endif # GAZEBO_DRIVERS
```

## drivers/gz_bridge/Kconfig
```kconfig
config GAZEBO_BRIDGE
    bool "Gazebo bridge implementation"
    depends on NANOPB
    depends on ZBUS_RUNTIME_CHANNEL_REGISTRATION
    depends on ZBUS_ASYNC_LISTENER
    depends on ZBUS_RUNTIME_OBSERVERS
    depends on ZBUS_CHANNEL_NAME
    depends on ZBUS_CHANNEL_ID

if GAZEBO_BRIDGE

config GAZEBO_BRIDGE_LINK_SOCKETS
    bool "Gazebo link using sockets"
    default y
    depends on NET_SOCKETS
    depends on NET_TCP
    depends on EVENTFD
    depends on (ZVFS_EVENTFD_MAX >= 1)
    depends on (ZVFS_POLL_MAX >= 2)
    depends on (NET_IF_UNICAST_IPV4_ADDR_COUNT >= 2)

endif # GAZEBO_BRIDGE
```

## drivers/sensor/Kconfig
```kconfig
menuconfig GAZEBO_SENSOR_DRIVERS
    bool "Gazebo sensor drivers"
    default y

if GAZEBO_SENSOR_DRIVERS

config GZ_IMU_SENSOR
    bool "Gazebo IMU sensor"
    default y
    depends on DT_HAS_GZ_IMU_ENABLED
    depends on SENSOR

endif # GAZEBO_SENSOR_DRIVERS
```

## dts/bindings/gz-bridge.yml
```yaml
description: |
  Gazebo bridge. Provides a communication channel between a running Gazebo world
  and it's components and the corresponding Zephyr drivers.

include: base.yaml

compatible: "gz-bridge"

bus: gz-bridge
```

## dts/bindings/gz-imu.yml
```yaml
description: |
    Gazebo IMU sensor

compatible: "gz-imu"

include: [gz-device.yml, sensor-device.yaml]

properties:
  topic:
    type: string
    required: true
```

## west.yml
```yaml
manifest:
  defaults:
    remote: zephyrproject-rtos
  remotes:
    - name: zephyrproject-rtos
      url-base: https://github.com/zephyrproject-rtos

  projects:
    - name: zephyr
      revision: v4.5.0
      path: zephyr
      import:
        name-allowlist:
          - nanopb
          - cmsis-dsp
```

## zephyr_gazebo/drivers/sensor/Kconfig
```kconfig
config GZ_IMU_SENSOR
    bool "Gazebo IMU sensor"
    default y
    depends on DT_HAS_GZ_IMU_ENABLED
    depends on SENSOR
```

## zephyr_gazebo/dts/bindings/gz-altimeter.yml
```yaml
description: |
    Gazebo altimeter sensor

compatible: "gz-alitmeter"

include: [gz-device.yml, sensor-device.yaml]

properties:
  topic:
    type: string
    required: true
```
