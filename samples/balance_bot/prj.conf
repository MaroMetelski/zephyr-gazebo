## CMakeLists.txt
```
cmake_minimum_required(VERSION 3.22.1)

# Add gazebo bridge snippet to enable the bridge
list(APPEND SNIPPET gz-bridge)

find_package(Zephyr REQUIRED HINTS $ENV{ZEPHYR_BASE})

project(balance_bot C)

target_sources(app PRIVATE
    src/main.c
    src/motors_gazebo.c
)
```

## prj.conf
```kconfig
# Kernel options
CONFIG_MAIN_STACK_SIZE=2048
CONFIG_INIT_STACKS=y

# Logging
CONFIG_LOG=y
CONFIG_PRINTK=y

# Network shell
CONFIG_SHELL=y
CONFIG_SENSOR_SHELL=y

CONFIG_SENSOR=y

CONFIG_CBPRINTF_FP_SUPPORT=y

# DSP library
CONFIG_CMSIS_DSP=y
```

## boards/native_sim.overlay
```dts
/ {
    aliases {
        bridge = &gz_bridge;
        imu = &imu;
    };

    gz_bridge: gz_bridge {
        compatible = "gz-bridge";
        status = "okay";

        imu: gz_imu {
            compatible = "gz-imu";
            status = "okay";
            topic = "/imu";
        };
    };
};
```

## src/main.c
```c
#include <stdbool.h>
#include <math.h>

#include <zephyr/logging/log.h>
#include <zephyr/device.h>
#include <drivers/gz_bridge.h>
#include <zephyr/drivers/sensor.h>
#include <dsp/controller_functions.h>

#include "motors.h"

LOG_MODULE_REGISTER(main, LOG_LEVEL_DBG);

#define IMU_NODE DT_ALIAS(imu)

const struct device *imu = DEVICE_DT_GET(IMU_NODE);

#ifndef M_PI
#define M_PI 3.14159265358979323846
#endif

/* Define whether wheels turn in the same direction as positive pitch or reverse. */
#define REVERSE 1

static double get_pitch(const double *accel)
{
	return -(atan2(accel[0], sqrt(accel[1] * accel[1] + accel[2] * accel[2])) * 180.0) / M_PI;
}

/* PID values for the simulated balance bot. */
static arm_pid_instance_f32 pid = {
	.Kd = 11.2,
	.Ki = 0.005,
	.Kp = 9.8,
};

static double pitch_setpoint = 0.0;

int main(void)
{
	bool reverse = (bool)REVERSE;
	arm_pid_init_f32(&pid, 1);
	motors_init();

	while (true) {
		struct sensor_value val[3] = {};
		double accel[3] = {};

		/* Get IMU data. */
		sensor_sample_fetch(imu);
		sensor_channel_get(imu, SENSOR_CHAN_ACCEL_XYZ, val);

		for (int i = 0; i < 3; i++) {
			accel[i] = sensor_value_to_double(&val[i]);
		}

		/* Calculate pitch. */
		double pitch = get_pitch(accel);

		/* Get PID output. */
		double err = pitch_setpoint - pitch;
		double force = (double)arm_pid_f32(&pid, err);

		if (reverse) {
			force = -force;
		}

		/* This should make the bot go in circles. */
		// double const_right = 200.0;
		// double const_left = -150.0;

		/* Apply force to motors. */
		motor_force_set(MOTOR_LEFT, force);
		motor_force_set(MOTOR_RIGHT, force);

		/* Loop delay. */
		k_sleep(K_MSEC(10));
	}

	return 0;
}
```

## src/motors.h
```c
/* motors.h Control motors' velocity for a balance bot.
 *
 * This is a simple API for the balance bot application that allows to control
 * the velocity of the motors in the system.
 *
 * The purpose of this module is to show how to implement a simulated variant
 * of some custom hadware control logic using the gazebo bridge. In that case,
 * the implementation is provided by the 'motors_gazebo.c' file.
 */
#ifndef MOTORS_H_
#define MOTORS_H_

#include <stdbool.h>

enum motor_instance { MOTOR_LEFT,
	MOTOR_RIGHT,
};

bool motors_init(void);

/* Set force for a motor instance. */
bool motor_force_set(enum motor_instance motor, double force);

#endif /* MOTORS_H_ */
```

## src/motors_gazebo.c
```c
/* motors_gazebo.c Implementation of motors.h API for simulation purposes.
 *
 */

#include "gz_message.pb.h"
#include "gz/msgs/double.pb.h"
#include "motors.h"
#include "pb.h"
#include <pb_encode.h>
#include <pb_decode.h>
#include <zephyr/device.h>
#include <drivers/gz_bridge.h>

#define WHEEL_RIGHT_TOPIC "/wheel_right"
#define WHEEL_LEFT_TOPIC  "/wheel_left"

#define DOUBLE_URL "/gz.msgs.Double"

/* Find the bridge node */
#define BRIDGE DT_COMPAT_GET_ANY_STATUS_OKAY(gz_bridge)

const struct device *bridge = DEVICE_DT_GET(BRIDGE);

static const char *get_topic_name(enum motor_instance motor)
{
	switch (motor) {
	case MOTOR_LEFT:
		return WHEEL_LEFT_TOPIC;
	case MOTOR_RIGHT:
		return WHEEL_RIGHT_TOPIC;
	default:
		return NULL;
	}
}

bool motors_init(void)
{
	/* Register Zephyr->Gazebo channels */
	int ret = gz_bridge_register_channel(bridge, "/wheel_right", ZEPHYR_TO_GAZEBO, NULL);
	ret = gz_bridge_register_channel(bridge, "/wheel_left", ZEPHYR_TO_GAZEBO, NULL);
	return 0;
}

bool motor_force_set(enum motor_instance motor, double force)
{
	GazeboMessage tx_msg = GazeboMessage_init_default;
	gz_msgs_Double dbl = gz_msgs_Double_init_zero;

	const char *topic_name = get_topic_name(motor);
	if (!topic_name) {
		return false;
	}

	dbl.data = force;

	strncpy(tx_msg.topic, topic_name, sizeof(tx_msg.topic));

	gz_bridge_encode_nested(&tx_msg, gz_msgs_Double_fields, DOUBLE_URL, &dbl);

	gz_bridge_send_message(bridge, topic_name, &tx_msg);

	return true;
}
```
